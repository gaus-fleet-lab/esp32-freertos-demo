## main/Kconfig.projbuild
```kconfig
menu "Gaus Demo Configuration"

config WIFI_SSID
    string "WiFi SSID"
	default "myssid"
	help
		SSID (network name) for the example to connect to.

config WIFI_PASSWORD
    string "WiFi Password"
	default "mypassword"
	help
		WiFi password (WPA or WPA2) for the example to use.

		Can be left blank if the network has no security set.

config GAUS_SERVER_URL
    string "Gaus server url"
	default "https://gaus.incubation.io/"
	help
		The url that this device should communicate with Gaus
		on.

		MUST be set in order for demo to work.

config GAUS_PRODUCT_ACCESS
    string "Gaus Product Access"
	default ""
	help
		The product access key for the product family this
		device belongs to.

		Can be found in the Gaus admin UI when creating a new
		product.

		MUST be set in order for the demo to work.

config GAUS_PRODUCT_SECRET
    string "Gaus Product Secret"
	default ""
	help
		The product secret key for the product family this
		device belongs to.

		Can be found in the Gaus admin UI when creating a new
		product.

		MUST be set in order for the demo to work.

config GAUS_DEVICE_ID
    string "Gaus Device ID"
    default ""
    help
        The unique identifier for this device.

        Can be set to something like a MAC address.

        MUST be set in order for the demo to work.

config GAUS_DEVICE_LOCATION
    string "Gaus Device Location"
    default "unknown"
    help
        The location for this device.  This is used to allow updating a group of devices by location.

        OPTIONAL: If unused can set to empty string or "unknown".

config EXAMPLE_DISPLAY_TYPE
    int
    default 0 if EXAMPLE_DISPLAY_TYPE0
    default 1 if EXAMPLE_DISPLAY_TYPE1
    default 2 if EXAMPLE_DISPLAY_TYPE2
    default 3 if EXAMPLE_DISPLAY_TYPE3
    default 4 if EXAMPLE_DISPLAY_TYPE4

    choice
        prompt "Select predefined display configuration"
        default EXAMPLE_DISPLAY_TYPE0
        help
            Select predefined display configuration

        config EXAMPLE_DISPLAY_TYPE0
            bool "None"
        config EXAMPLE_DISPLAY_TYPE1
            bool "ESP-WROVER-KIT Display"
        config EXAMPLE_DISPLAY_TYPE2
            bool "Adafruit TFT Feather display"
        config EXAMPLE_DISPLAY_TYPE3
            bool "M5Stack TFT display"
        config EXAMPLE_DISPLAY_TYPE4
            bool "Adafruit tft feather mini display"
    endchoice
endmenu
```
